## meta-openautosar/conf/distro/include/openautosar-agl-pin.inc
```bitbake
# SPDX-License-Identifier: MIT

OPENAUTOSAR_TARGET = "qemux86-64-agl-unagi"
OPENAUTOSAR_AGL_RELEASE_NAME = "Ultimate Unagi"
OPENAUTOSAR_AGL_RELEASE_VERSION = "21.0.2"
OPENAUTOSAR_AGL_BRANCH = "unagi"
OPENAUTOSAR_AGL_MANIFEST = "unagi_21.0.2.xml"
OPENAUTOSAR_YOCTO_RELEASE = "scarthgap-5.0.18"

MACHINE ??= "qemux86-64"
```

## meta-openautosar/conf/layer.conf
```bitbake
# SPDX-License-Identifier: MIT

BBPATH .= ":${LAYERDIR}"

BBFILES += "${LAYERDIR}/recipes-*/*/*.bb \
            ${LAYERDIR}/recipes-*/*/*.bbappend"

BBFILE_COLLECTIONS += "openautosar"
BBFILE_PATTERN_openautosar = "^${LAYERDIR}/"
BBFILE_PRIORITY_openautosar = "7"

LAYERSERIES_COMPAT_openautosar = "scarthgap"

OPENAUTOSAR_LAYER_DIR := "${LAYERDIR}"
OPENAUTOSAR_SOURCE_DIR ??= "${OPENAUTOSAR_LAYER_DIR}/.."

OPENAUTOSAR_AGL_RELEASE_NAME = "Ultimate Unagi"
OPENAUTOSAR_AGL_RELEASE_VERSION = "21.0.2"
OPENAUTOSAR_AGL_BRANCH = "unagi"
OPENAUTOSAR_AGL_MANIFEST = "unagi_21.0.2.xml"
OPENAUTOSAR_YOCTO_RELEASE = "scarthgap-5.0.18"
OPENAUTOSAR_MACHINE = "qemux86-64"
```

## meta-openautosar/wic/openautosar-reference-ab.wks
```
# SPDX-License-Identifier: MIT

part /boot --source bootimg-pcbios --ondisk sda --label boot --active --align 1024 --size 64
part / --source rootfs --ondisk sda --fstype=ext4 --label rootfs-a --align 1024 --size 2048
part /rootfs-b --ondisk sda --fstype=ext4 --label rootfs-b --align 1024 --size 2048
part /appfs-a --ondisk sda --fstype=ext4 --label appfs-a --align 1024 --size 512
part /appfs-b --ondisk sda --fstype=ext4 --label appfs-b --align 1024 --size 512
part /data --ondisk sda --fstype=ext4 --label data --align 1024 --size 512

bootloader --ptable gpt
```
